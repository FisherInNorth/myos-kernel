## makecv1811/cv1811.its
```
/dts-v1/;

/ {
        description = "Image file for the QorIQ ARM 32b Linux Kernel";
        #address-cells = <1>;

        images {
        kernel-1 {
                description = "cvitek kernel zCore for cr1825";
                data = /incbin/("./os.bin");
                type = "kernel";
                arch = "riscv";
                os = "linux";
                compression = "none";
                load = <0x0 0x80200000>;
                entry = <0x0 0x80200000>;
/*                hash-2 {
                        algo = "crc32";
                };*/
        };
        /*FDT*/
        fdt-cv1811h_wevb_0007a_emmc {
                description = "cvitek device tree - cv1811h_wevb_0007a_emmc";
                data = /incbin/("./fdt");
                type = "flat_dt";
                arch = "riscv";
                compression = "none";
/*                hash-1 {
                        algo = "sha256";
                };  */
        };
};
        /*CFG*/
        configurations {
                default = "config-cv1811h_wevb_0007a_emmc";
                config-cv1811h_wevb_0007a_emmc {
                        description = "boot cvitek system with board cv1811h_wevb_0007a_emmc";
                        kernel = "kernel-1";
                        fdt = "fdt-cv1811h_wevb_0007a_emmc";
                };
        };
};
```
